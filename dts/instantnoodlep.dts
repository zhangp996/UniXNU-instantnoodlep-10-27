/dts-v1/;
/include/ "sm8250.dtsi"

/ {
    model = "OnePlus 8 Pro (IN2020)";
    compatible = "oneplus,instantnoodlep", "qcom,sm8250";

    memory@80000000 {
        device_type = "memory";
        reg = <0x0 0x80000000 0x2 0x00000000>;
    };
};

// The SoC description ships the UFS host and its QMP PHY disabled, to be enabled by a board that
// selects a reviewed storage component. ShengUfs does not need them: it attaches to the platform
// expert and takes the controller windows from the SoC repository's ufs-soc-table.h. Enabling them
// for this port hung the kernel before its console (the ADT grew to 14400 bytes and the hand-off
// stopped after the entry-probe bars), while the same kernel with the nodes disabled boots to the
// known root-mount panic; the nodes stay disabled until that difference is explained. See
// docs/evidence/2026-11-10-storage-link.md.

